/* source keypos definitions
#include "../zmk-nodefree-config/keypos_def/keypos_42keys.h"
*/

#include "zmk-helpers/key-labels/42.h"


#define NAV 1

/* map Corne's extra keys */
#define X_LT &kp RC(RG(Q))
#define X_LM &kp LS(RETURN)
#define X_LB &kp (LG(D))
#define X_LH &none

#define X_RT &none
#define X_RM &tog NAV
#define X_RB &kp LG(LS(LA(R)))
#define X_RH &none

/* activate bluetooth */
#define CONFIG_WIRELESS 1

/* source the main keymap */
#include "base.keymap"
